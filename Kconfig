## Kconfig
```kconfig
# Copyright (c) 2024 The ZMK Contributors
# SPDX-License-Identifier: MIT

config ZMK_MOUSE_GESTURE
	bool "Enable mouse gesture support"
	default y
	depends on ZMK_POINTING
	help
	  Enable mouse gesture support for ZMK.
	  This allows converting sequences of mouse movements into key presses.

config INPUT_THREAD_STACK_SIZE
	default 2048 if ZMK_MOUSE_GESTURE
```
